## image/Config.in
```kconfig
menu "Umicom OS Foundation"
source "$BR2_EXTERNAL_UMICOM_OS_PATH/package/umicom-os-init/Config.in"
source "$BR2_EXTERNAL_UMICOM_OS_PATH/package/umicom-framework-probe/Config.in"
endmenu
```

## image/package/umicom-framework-probe/Config.in
```kconfig
config BR2_PACKAGE_UMICOM_FRAMEWORK_PROBE
    bool "Umicom Framework normal user-space probe"
    depends on BR2_USE_MMU
    help
      Packages actual canonical Framework source captured by os_image.py.
      This normal workload can fail without disabling minimal recovery.
```

## image/package/umicom-os-init/Config.in
```kconfig
config BR2_PACKAGE_UMICOM_OS_INIT
    bool "Umicom independent boot and recovery"
    depends on BR2_USE_MMU
    help
      Minimal PID 1 and a read-only recovery console. No Framework or GTK
      dependency. It never formats or mounts a persistent data device.
```
